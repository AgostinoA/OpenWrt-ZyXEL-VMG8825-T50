## firmwares/vmg8825_t50k_default_release/package/boot/uboot-qca/src/board/ipq807x/Kconfig
```kconfig
config SYS_CPU
       default "ipq807x"

config SYS_BOARD
       default "ipq807x"

config SYS_VENDOR
       default "qca/arm"

config SYS_CONFIG_NAME
       default "ipq807x"
```

## firmwares/vmg8825_t50k_default_release/package/network/services/dnsmasq/Config.in
```kconfig
config dnsmasq_releaseno
	string
	prompt "specify dnsmasq release no" if PACKAGE_dnsmasq
	default "2.67"

config dnsmasq_dnssec
	bool
	prompt "enable/disable dnsmasq dnssec" if PACKAGE_dnsmasq
	default 0
```

## firmwares/vmg8825_t50k_default_release/target/linux/en75xx/Config.in
```kconfig
menu "econet platform configuration"
	depends on TARGET_en75xx
#
# ECONET platform configuration
#
choice
	prompt "Select Trendchip SDK version"
	default TC_SDK_7_3_207_4

config TC_SDK_7_3_207_4
	bool "Trendchip SDK2.0 7.3.207.4"
	help
	      Trendchip SDK2.0 7.3.207.4 using for EN7512
config TC_SDK_7_3_235_200
	bool "Trendchip SDK2.0 7.3.235.200"
	help
	      Trendchip SDK2.0 7.3.235.200 using for EN7521
config TC_SDK_7_3_245_300
	bool "Trendchip SDK2.0 7.3.245.300"
	help
	      Trendchip SDK2.0 7.3.245.300 using for EN7516
endchoice

config TC_SDK_VERSION
	string
	default "7.3.207.4"		if TC_SDK_7_3_207_4
	default "7.3.235.200"	if TC_SDK_7_3_235_200
	default "7.3.245.300"	if TC_SDK_7_3_245_300

config CUSTOM_SDK_PREFIX
	string "Prefix for SDK configuration file"
	default "EN75XXSDK" if TC_SDK_7_3_207_4
	default "EN7521SDK" if TC_SDK_7_3_235_200
	default "EN7516SDK" if TC_SDK_7_3_245_300
	help
		This prefix will be used for add in front of the SDK configuration.
		For example, CONFIG_$(CUSTOM_SDK_PREFIX)_TCSUPPORT_CPU_MT7520
		original configuration was TCSUPPORT_CPU_MT7520

config TC_RULE_MAK
	string "Target tc_rule.mak used by different SDK version"
	default "tc_rule.mak" if TC_SDK_7_3_207_4
	default "tc_rule_7_3_235_200.mak" if TC_SDK_7_3_235_200
	default "tc_rule_7_3_245_300.mak" if TC_SDK_7_3_245_300

if TC_SDK_7_3_207_4
source "target/linux/en75xx/kconfigs/Config.in"
endif

if TC_SDK_7_3_235_200
source "target/linux/en75xx/kconfigs/Config_7_3_235_200.in"
endif

if TC_SDK_7_3_245_300
source "target/linux/en75xx/kconfigs/Config_7_3_245_300.in"
endif

endmenu
```

## firmwares/vmg8825_t50k_default_release/toolchain/binutils/Config.in
```kconfig
# Choose binutils version.

choice
	prompt "Binutils Version" if TOOLCHAINOPTS
	default BINUTILS_VERSION_2_20_1 if avr32
	default BINUTILS_VERSION_2_22 if !avr32
	default BINUTILS_VERSION_2_24 if !avr32
	help
	  Select the version of binutils you wish to use.

	config BINUTILS_VERSION_2_19_1
		bool "binutils 2.19.1"

	config BINUTILS_VERSION_2_19_92
		bool "binutils 2.19.92"

	config BINUTILS_VERSION_2_20
		bool "binutils 2.20"

	config BINUTILS_VERSION_2_20_1
		depends on avr32
		bool "binutils 2.20.1"

	config BINUTILS_VERSION_2_21
		depends on !avr32 || (avr32 && BROKEN)
		bool "binutils 2.21"

	config BINUTILS_VERSION_2_21_1
		depends on !avr32 || (avr32 && BROKEN)
		bool "binutils 2.21.1"

	config BINUTILS_VERSION_2_22
		depends on !avr32 || (avr32 && BROKEN)
		bool "binutils 2.22"

	config BINUTILS_VERSION_2_23_1
		depends on !avr32 || (avr32 && BROKEN)
		bool "binutils 2.23.1"

	config BINUTILS_VERSION_2_25_1
		default y if (!TOOLCHAINOPTS && !arc)
		bool "binutils 2.25.1"

	config BINUTILS_VERSION_2_24
		depends on !avr32 || (avr32 && BROKEN)
		bool "binutils 2.24"

	config BINUTILS_VERSION_2_28_1
		default y if (!TOOLCHAINOPTS && !arc)
		bool "binutils 2.28.1"

endchoice

config EXTRA_BINUTILS_CONFIG_OPTIONS
	string
	prompt "Additional binutils configure options" if TOOLCHAINOPTS
	default ""
	help
	    Any additional binutils options you may want to include....

config BINUTILS_DISABLE_NLS
	bool
	prompt "Disable NLS" if TOOLCHAINOPTS
	default y

config BINUTILS_VERSION
	string
	prompt "Binutils Version" if (TOOLCHAINOPTS && NULL)
	default "2.19.1"          if BINUTILS_VERSION_2_19_1
	default "2.19.92"          if BINUTILS_VERSION_2_19_92
	default "2.20"            if BINUTILS_VERSION_2_20
	default "2.20.1"          if BINUTILS_VERSION_2_20_1
	default "2.21"            if BINUTILS_VERSION_2_21
	default "2.21.1"          if BINUTILS_VERSION_2_21_1
	default "2.22"            if BINUTILS_VERSION_2_22
	default "2.24"            if BINUTILS_VERSION_2_24
	default "2.23.1"	  if BINUTILS_VERSION_2_23_1
	default "2.20.1"          if avr32
	default "2.25.1"          if BINUTILS_VERSION_2_25_1
	default "2.28.1"          if BINUTILS_VERSION_2_28_1
	default "2.22"
```

## firmwares/vmg8825_t50k_default_release/toolchain/external_kernel_toolchain/Config.in
```kconfig
#TEST

menuconfig EXTERNAL_KERNEL_TOOLCHAIN
	bool
	prompt "Use external toolchain for kernel"
	help
	  If enabled, OpenWrt will compile kernel module with an existing toolchain instead of compiling one

	config KERNEL_TARGET_NAME
		string
		prompt "Target name"  if DEVEL
		depends on EXTERNAL_KERNEL_TOOLCHAIN
		default "aarch64-openwrt-linux-gnu"

	config KERNEL_TOOLCHAIN_PREFIX
		string
		prompt "Kernel toolchain prefix"
		depends on EXTERNAL_KERNEL_TOOLCHAIN
		default "aarch64-openwrt-linux-gnu"

	config KERNEL_TOOLCHAIN_ROOT
		string
		prompt "Kernel toolchain root"
		depends on EXTERNAL_KERNEL_TOOLCHAIN
		default "/opt/cross/aarch64-unknown-linux-gnu"

	config KERNEL_TOOLCHAIN_BIN_PATH
		string
		prompt "Kernel toolchain program path"
		depends on EXTERNAL_KERNEL_TOOLCHAIN
		default "./usr/bin ./bin"
		help
		  Specify additional directories searched for kernel toolchain binaries (override PATH)
		  Use ./DIR for directories relative to the root above

	config KERNEL_TOOLCHAIN_INC_PATH
		string
		prompt "Kernel toolchain include path"
		depends on EXTERNAL_KERNEL_TOOLCHAIN
		default "./usr/include ./include"
		help
		  Specify additional directories searched for header files (override CPPFLAGS)
		  Use ./DIR for directories relative to the root above

	config KERNEL_TOOLCHAIN_LIB_PATH
		string
		prompt "Kernel toolchain library path"
		depends on EXTERNAL_KERNEL_TOOLCHAIN
		default "./usr/lib ./lib"
		help
		  Specify additional directories searched for libraries (override LDFLAGS)
		  Use ./DIR for directories relative to the root above

	config KERNEL_TOOLCHAIN_TARGET
		string
		prompt "Kernel toolchain for which openWRT target"
		depends on EXTERNAL_KERNEL_TOOLCHAIN
		default "brcm963xx"

	config KERNEL_TOOLCHAIN_CPU_ARCH
		string
		prompt "Kernel toolchain for which CPU arch"
		depends on EXTERNAL_KERNEL_TOOLCHAIN
		default "aarch64"

	config KERNEL_TOOLCHAIN_GCC_VERSION
		string
		prompt "Kernel toolchain use which GCC version"
		depends on EXTERNAL_KERNEL_TOOLCHAIN
		default "5.5.0"

	config KERNEL_TOOLCHAIN_GLIBC_VERSION
		string
		prompt "Kernel toolchain for which glibc version"
		depends on EXTERNAL_KERNEL_TOOLCHAIN
		default "2.26"

	config KERNEL_TOOLCHAIN_TARGET_SUFFIX
		string
		prompt "Kernel target suffix"
		depends on EXTERNAL_KERNEL_TOOLCHAIN
		default "gnu"

	config KERNEL_TOOLCHAIN_TARGET_OPTIMIZATION
		string
		prompt "Kernel target optimization"
		depends on EXTERNAL_KERNEL_TOOLCHAIN
		default "-Os -pipe -mcpu=cortex-a53"
```

## firmwares/vmg8825_t50k_default_release/toolchain/uClibc/Config.in
```kconfig
# Choose uclibc version.

choice
	prompt "uClibc Version"
	depends on TOOLCHAINOPTS && USE_UCLIBC
	default UCLIBC_USE_VERSION_0_9_33
	help
	  Select the version of uClibc you wish to use.

	config UCLIBC_USE_VERSION_0_9_33
		select UCLIBC_VERSION_0_9_33
		bool "uClibc 0.9.33.2"

	config UCLIBC_USE_VERSION_0_9_32
		select UCLIBC_VERSION_0_9_32
		bool "uClibc 0.9.32"

	config UCLIBC_USE_VERSION_0_9_30_3
		select UCLIBC_VERSION_0_9_30_3
		bool "uClibc 0.9.30.3"

	config UCLIBC_USE_VERSION_0_9_29
		select UCLIBC_VERSION_0_9_29
		bool "uClibc 0.9.29"

endchoice

# Debug version.

config UCLIBC_ENABLE_DEBUG
	bool "Build with debug information"
	depends on TOOLCHAINOPTS && USE_UCLIBC
	default n
```

## stock/package/boot/uboot-zyxel/Config.in
```kconfig
menu "uboot-zyxel Configuration"
	depends on PACKAGE_uboot-zyxel

config UBOOT_ZYXEL_RAMBOOT
	bool "Enable RAM boot image"
	help
	  To build u-boot image for booting from RAM not ROM.
	  While executing the image in the RAM the functionality of the uboot image can be tested first without touching 
	  the original flash.
	  Note: Be carefull, by saving the environment the flash will be modified.

config UBOOT_ZYXEL_TARGET
	string "u-boot config"
	default "rt6856evm" if TARGET_rt6856_rt6856evm
	default "amitsample" if TARGET_rt6856_amitsample
	default "nbg5615" if TARGET_rt6856_nbg5615
	default "pla4231" if TARGET_ar934x_pla4231

config UBOOT_ZYXEL_SUPPORT_ROMD
	bool "Support ROM_D partition"
	default n
	help
		Support ROM_D partition

config UBOOT_ZYXEL_SUPPORT_ZLOADER
	bool "Support for ZyXEL zloader"
	default y
	depends on PACKAGE_zloader

config UBOOT_ZYXEL_ZLOADER_OFFSET
	int "The offset of zloader in ZLD image"
	default 131072
	depends on UBOOT_ZYXEL_SUPPORT_ZLOADER
	help
		The offset to fetch the zloader from ZLD image.
endmenu
```
