//============================================================================
//  Name:                                                                     
//    std_extensions.cmm 
//
//  Description:                                                              
//    None 
//                                                                            
// Copyright (c) 2018 by QUALCOMM, Incorporated.  All Rights Reserved.        
//============================================================================
//                                                                            
// *** AUTO GENERATED FILE - DO NOT EDIT                                      
//                                                                            
// GENERATED: Thu Mar 15 08:20:56 2018 
//============================================================================

ENDDO