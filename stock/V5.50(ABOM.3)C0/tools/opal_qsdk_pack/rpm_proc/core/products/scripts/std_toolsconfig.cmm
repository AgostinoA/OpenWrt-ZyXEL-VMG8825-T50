//============================================================================
//  Name:                                                                     
//    std_toolsconfig.cmm 
//
//  Description:                                                              
//    None 
//                                                                            
// Copyright (c) 2018 by QUALCOMM, Incorporated.  All Rights Reserved.        
//============================================================================
//                                                                            
// *** AUTO GENERATED FILE - DO NOT EDIT                                      
//                                                                            
// GENERATED: Thu Mar 15 08:20:56 2018 
//============================================================================


GLOBAL &RPM_ABS_BUILD_ROOT
GLOBAL &RPM_BUILD_ROOT
GLOBAL &RPM_CBSP_ROOT
GLOBAL &CHIPSET
GLOBAL &RPM_SCRIPTSDIR
GLOBAL &RPM_BUILDMSDIR



&RPM_ABS_BUILD_ROOT="/local/mnt/workspace/CRMBuilds/RPM.BF.2.4.1-00025-IPQ8074AAAAANAZR-1_20180315_081753/b/rpm_proc"
&RPM_BUILD_ROOT=os.ppd()+"/../../.."
&RPM_CBSP_ROOT=os.ppd()+"/../.."
&CHIPSET="8074"
&RPM_SCRIPTSDIR=os.ppd()+"/../../products"
&RPM_BUILDMSDIR=os.ppd()+"/../../../rpm/build/ms"


ENDDO